## config/west.yml
```yaml
manifest:
  remotes:
    - name: zmkfirmware
      url-base: https://github.com/zmkfirmware
    - name: tuanha168 #new entry
      url-base: https://github.com/tuanha168 #new entry
  projects:
    - name: zmk
      remote: zmkfirmware
      revision: main
      import: app/west.yml
    - name: nice-view-gem #new entry
      remote: tuanha168 #new entry
      revision: main #new entry
  self:
    path: config
```
